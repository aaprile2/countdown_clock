#include <Wire.h>
#include <RTClib.h>
#include <Adafruit_GFX.h>
#include <Adafruit_SH1106.h>

// Reset PIN
#define OLED_RESET 4 

// Module instantiations
RTC_DS3231 rtc;
Adafruit_SH1106 display(OLED_RESET);

// Global variables
//// Target date
const DateTime endDate = DateTime(2025, 6, 16, 0, 0, 0); //// Target date

//// Observed drift (s)
const int drift = 15; 

//// Party light controls
const int ledPins[] = {9, 10, 11, 12}; 
const int numPins = sizeof(ledPins) / sizeof(ledPins[0]); 
const int numStates = numPins / 2;
unsigned long previousTime;
int state; 
const unsigned long interval = 500; //// Blink interval (ms)

//// Milestone bitmaps
const unsigned char intro [] PROGMEM = {
	// 'Screenshot 2025-02-22 at 6, 128x64px
	0xff, 0xff, 0xff, 0xff, 0xff, 0xff, 0xff, 0xff, 0xff, 0xff, 0xff, 0xff, 0xff, 0xff, 0xff, 0xff, 
	0xff, 0xff, 0xff, 0xff, 0xff, 0xff, 0xff, 0xff, 0xff, 0xff, 0xff, 0xff, 0xff, 0xff, 0xff, 0xff, 
	0xff, 0xff, 0xff, 0xff, 0xff, 0xff, 0xff, 0xff, 0xff, 0xff, 0xff, 0xff, 0xff, 0xff, 0xff, 0xff, 
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	0xff, 0xff, 0xff, 0xff, 0xff, 0xff, 0xff, 0xff, 0xff, 0x83, 0xfe, 0x0f, 0xff, 0xff, 0xff, 0xff
};

const unsigned char one [] PROGMEM = {
	0xff, 0xff, 0xff, 0xff, 0xff, 0xff, 0xff, 0xff, 0xff, 0xff, 0xff, 0xff, 0xff, 0xff, 0xff, 0xff, 
	0xff, 0xff, 0xff, 0xff, 0xff, 0xff, 0xff, 0xff, 0xff, 0xff, 0xff, 0xff, 0xff, 0xff, 0xff, 0xff, 
	0xff, 0xff, 0xff, 0xff, 0xff, 0xff, 0xff, 0xff, 0xff, 0xff, 0xff, 0xff, 0xff, 0xff, 0xff, 0xff, 
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	0xff, 0xff, 0xff, 0xff, 0xff, 0xff, 0xff, 0xff, 0xff, 0xff, 0xff, 0xff, 0xff, 0xff, 0xff, 0xff
};

const unsigned char ten [] PROGMEM = {
	0xff, 0xff, 0xff, 0xff, 0xff, 0xff, 0xff, 0xff, 0xff, 0xff, 0xff, 0xff, 0xff, 0xff, 0xff, 0xff, 
	0xff, 0xff, 0xff, 0xff, 0xff, 0xff, 0xff, 0xff, 0xff, 0xff, 0xff, 0xff, 0xff, 0xff, 0xff, 0xff, 
	0xff, 0xff, 0xff, 0xff, 0xff, 0xff, 0xff, 0xff, 0xff, 0xff, 0xff, 0xff, 0xff, 0xff, 0xff, 0xff, 
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	0xff, 0xff, 0xff, 0xff, 0xff, 0xff, 0xff, 0xff, 0xff, 0xff, 0xff, 0xff, 0xff, 0xff, 0xff, 0xff
};

const unsigned char twentyFive [] PROGMEM = {
	0xff, 0xff, 0xff, 0xff, 0xff, 0xff, 0xff, 0xff, 0xff, 0xff, 0xff, 0xff, 0xff, 0xff, 0xff, 0xff, 
	0xff, 0xff, 0xff, 0xff, 0xff, 0xff, 0xff, 0xff, 0xff, 0xff, 0xff, 0xff, 0xff, 0xff, 0xff, 0xff, 
	0xff, 0xff, 0xf8, 0xff, 0xff, 0xff, 0xff, 0xff, 0xff, 0xff, 0xff, 0xff, 0xff, 0xff, 0xff, 0xff, 
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	0xff, 0xff, 0xff, 0xff, 0xff, 0xff, 0xff, 0xff, 0xff, 0xff, 0xff, 0xff, 0xff, 0xff, 0xff, 0xff
};

const unsigned char fifty [] PROGMEM = {
	0xff, 0xff, 0xff, 0xff, 0xff, 0xff, 0xff, 0xff, 0xff, 0xff, 0xff, 0xff, 0xff, 0xff, 0xff, 0xff, 
	0xff, 0xff, 0xff, 0xff, 0xff, 0xff, 0xff, 0xff, 0x3f, 0xff, 0xff, 0xff, 0xff, 0xff, 0xff, 0xff, 
	0xff, 0xff, 0xff, 0xff, 0xff, 0xff, 0xff, 0xa5, 0xf7, 0xff, 0xff, 0xff, 0xff, 0xff, 0xff, 0xff, 
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	0xff, 0xff, 0xff, 0xff, 0xff, 0xff, 0xff, 0xff, 0xff, 0xff, 0xff, 0xff, 0xff, 0xff, 0xff, 0xff
};

const unsigned char oneHundred [] PROGMEM = {
	// 'snoopy-woodstock-peanut-gang, 128x64px
	0xff, 0xff, 0xff, 0xff, 0xff, 0xff, 0xff, 0xff, 0xff, 0xff, 0xff, 0xff, 0xff, 0xff, 0xff, 0xff, 
	0xff, 0xff, 0xff, 0xff, 0xff, 0xff, 0xff, 0xff, 0xff, 0xff, 0xff, 0xff, 0xff, 0xff, 0xff, 0xff, 
	0xff, 0xff, 0xff, 0xff, 0xff, 0xff, 0xff, 0xff, 0xff, 0xff, 0xff, 0xff, 0xfd, 0xff, 0xff, 0xff, 
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	0xff, 0xff, 0xff, 0xff, 0xff, 0xff, 0xff, 0xff, 0xff, 0xff, 0xff, 0xff, 0xff, 0xff, 0xff, 0xff
};

const unsigned char party [] PROGMEM = {
	// 'Screenshot 2025-02-22 at 5, 128x64px
	0xff, 0xff, 0xff, 0xff, 0xff, 0xff, 0xff, 0xff, 0xff, 0xff, 0xff, 0xff, 0xff, 0xff, 0xff, 0xff, 
	0xff, 0xff, 0xff, 0xff, 0xff, 0xff, 0xff, 0xff, 0xff, 0xff, 0xff, 0xff, 0xff, 0xff, 0xff, 0xff, 
	0xff, 0xff, 0xff, 0xff, 0xff, 0xff, 0x80, 0x0f, 0xff, 0xff, 0xff, 0xff, 0xff, 0xff, 0xff, 0xff, 
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	0xff, 0xff, 0xff, 0xff, 0xff, 0xff, 0xff, 0xff, 0xff, 0xff, 0xff, 0xff, 0xff, 0xff, 0xff, 0xff
};


void setup()
{
  Serial.begin(9600);
  Wire.begin();

  // RTC setup
  if (!rtc.begin())
  {
    Serial.println("RTC module not present!");
    for(;;); // Loops execution
  }
  // if (rtc.lostPower()) 
  // {
  //   // Adjusts to compile time
  //   rtc.adjust(DateTime(F(__DATE__),F(__TIME__)));
  // }
  // Uncomment and run if recompiling 
  // rtc.adjust(DateTime(F(__DATE__),F(__TIME__)));

  Serial.println(F("RTC module present."));

  // LED setup
  for (int i = 0; i < numPins; ++i) {
    pinMode(ledPins[i], OUTPUT);
    digitalWrite(ledPins[i], LOW);
  }
  Serial.println(F("LEDs connected."));

  // OLED display setup
  display.begin(SH1106_SWITCHCAPVCC, 0x3C); // Address 0x3C for 128x64
  Serial.println(F("OLED module connected."));
  display.clearDisplay();
  displayImg(intro); // Display custom intro message
  delay(10000);
  display.clearDisplay();
}


void loop()
{
  display.clearDisplay();
  DateTime now = rtc.now();
  rtcLogger(now);

  // Compute seconds until target date
  long diffSecs = endDate.unixtime() - (now.unixtime() + drift);

  // Convert to days
  //// If difference is greater than 0, round to nearest day; otherwise, set to 0
  //// Note: 86400 seconds in a full day
  long countdown = (diffSecs > 0) ? (diffSecs + 86399) / 86400 : 0;

  switch(countdown) {
    case 0:
      display.clearDisplay();
      displayImg(party);
      partyLights();
      break;
    case 1:
      display.clearDisplay();
      displayImg(one);
      break;
    case 10:
      display.clearDisplay();
      displayImg(ten);
      break;
    case 25:
      display.clearDisplay();
      displayImg(twentyFive);
      break;
    case 50:
      display.clearDisplay();
      displayImg(fifty);
      break;
    case 100:
      display.clearDisplay();
      displayImg(oneHundred);
      break;
    default:
      display.clearDisplay();
      displayCountdown(countdown);
      break;
  };

}


// Helper Functions
//// Displays number of days
void displayCountdown(int count) {
      display.setTextSize(6);
      display.setTextColor(WHITE);
      if (count > 99) display.setCursor(10, 10);
      else if (count > 9) display.setCursor(32, 10);
      else display.setCursor(51, 10);
      display.println(count);
      display.display();
}

//// Displays 128x64 bitmap
void displayImg(const unsigned char* img) {
  display.clearDisplay();
  display.drawBitmap(
    (display.width() - 128),
    (display.height() - 64),
    img, 128, 64, 1);
  display.display();
}

//// Blinks LEDs in alternating pattern
void partyLights(void) {
  // https://forum.arduino.cc/t/how-do-i-blink-multiple-leds-in-a-sequence-using-millis/878638
  unsigned long currentMillis = millis();

  if (currentMillis - previousTime >= interval) {
        previousTime = currentMillis;
    digitalWrite(ledPins[state*2], LOW);
    digitalWrite(ledPins[state*2+1], LOW);
    state++;
    if ( state >= numStates ) {
      state = 0;
    }
    digitalWrite(ledPins[state*2], HIGH);
    digitalWrite(ledPins[state*2+1], HIGH);
  }
}

//// Logs current RTC data to Serial Monitor (YYYY/MM/DD HH:MM:SS)
void rtcLogger(DateTime now) {
  Serial.print("RTC reading: ");
  Serial.print(now.year(), DEC);
  Serial.print('/');
  Serial.print(now.month(), DEC);
  Serial.print('/');
  Serial.print(now.day(), DEC);
  Serial.print(' ');
  Serial.print(now.hour(), DEC);
  Serial.print(':');
  Serial.print(now.minute(), DEC);
  Serial.print(':');
  Serial.print(now.second(), DEC);
  Serial.println();
}
